## boards/shields/Splayer1/Kconfig.defconfig
```kconfig
if SHIELD_SPLAYER1_LEFT

config ZMK_KEYBOARD_NAME
    default "Splayer1"

config ZMK_SPLIT_ROLE_CENTRAL
    default y

endif

if SHIELD_SPLAYER1_LEFT || SHIELD_SPLAYER1_RIGHT

config ZMK_SPLIT
    default y

endif
```

## boards/shields/Splayer1/Kconfig.shield
```kconfig
config SHIELD_SPLAYER1_LEFT
    def_bool $(shields_list_contains,splayer1_left)

config SHIELD_SPLAYER1_RIGHT
    def_bool $(shields_list_contains,splalyer1_right)
```
